## arch/arm/hotplug/Kconfig
```kconfig
config INTELLI_PLUG
        bool "Enable intelli-plug cpu hotplug driver"
        default n
        help
          Generic Intelli-plug cpu hotplug driver for ARM SOCs

config ALUCARD_HOTPLUG
	bool "Enable alucard-hotplug cpu hotplug driver"
	default y
	help
	  Generic Alucard-hotplug cpu hotplug driver for ARM SOCs

config BRICKED_HOTPLUG
	bool "Enable kernel based mpdecision"
	default n
	help
	  This enables kernel based multi core control.
	  (up/down hotplug based on load)

config MSM_HOTPLUG
	bool "MSM hotplug driver"
	depends on HOTPLUG_CPU
	default y
	help
	  The MSM hotplug driver controls on-/offlining of additional cores based
	  on current cpu load.

config MAKO_HOTPLUG
	bool "mako hotplug driver"
	default n
	help
	  easy HOTPLUG driver made by franciscofranco
```
